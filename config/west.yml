## config/west.yml
```yaml
manifest:
  remotes:
    - name: zmkfirmware
      url-base: https://github.com/zmkfirmware
    - name: rizalfr
      url-base: https://github.com/rizalfr
  projects:
    - name: zmk
      remote: rizalfr
      revision: rable_v2
      import: app/west.yml
  self:
    path: config
```
